## devicetree/bindings/serial/st,stm32u5-uart.yaml
```yaml
# SPDX-License-Identifier: (GPL-2.0 OR BSD-2-Clause)
# Copyright (C) STMicroelectronics 2022.
%YAML 1.2
---
$id: "st,stm32u5-uart.yaml#"
$schema: "http://devicetree.org/meta-schemas/core.yaml#"

maintainers:
  - Valentin Monnot <valentin.monnot@st.com>

title: STMicroelectronics STM32U5 USART bindings

properties:
  compatible:
    - st,stm32u5-uart

  reg:
    maxItems: 1

  interrupts:
    maxItems: 1

  clocks:
    maxItems: 1
    $ref: /schemas/types.yaml#/definitions/

  resets:
    maxItems: 1

  label:
    description: label associated with this uart
    $ref: /schemas/types.yaml#/definitions/string

  pinctrl:
    $nodename:
      pattern: "^pinctrl-[0-9a-f]$"
    $ref: /schemas/types.yaml#/definitions/phandle

required:
  - compatible
  - reg
  - interrupts
  - clocks
  - pinctrl

allOf:
  - $ref: serial.yaml#

examples:
  - |
    #include <dt-bindings/clock/stm32u5-clks.h>
    #include <dt-bindings/pinctrl/stm32-pinfunc.h>

    pinctrl: pin-controller@42020000{
      compatible = "st,stm32u5-pinctrl"
      usart1_pins_a: usart1-0{
        pins1{
          bias-disable;
          drive-push-pull;
          pinmux = <"GPIOA" 0x9 AF7>;
          slew-rate = <0>;
        };
        pins2{
          bias-disable;
          pinmux = <"GPIOA" 0xa AF7)>;
          slew-rate = <0>;
        };
      };
    };

    usart1: serial@40011000 {
      compatible = "st,stm32u5-uart";
      reg = <0x40013800 0x400>;
      interrupts = <61>;
      clocks = <&rcc USART1_CK>;
      pinctrl-0 = <&usart1_pins_a>
    };
```
